## soc/arm/atmel_sam0/samr30/Kconfig.defconfig.series
```kconfig
# Atmel SAML MCU series configuration options

# Copyright (c) 2021 Argentum Systems Ltd.
# SPDX-License-Identifier: Apache-2.0

if SOC_SERIES_SAMR30

config SOC_SERIES
	default "samr30"

config SOC_PART_NUMBER
	default "samr30m18a" if SOC_PART_NUMBER_SAMR30M18A

config NUM_IRQS
	default 29

config SYS_CLOCK_HW_CYCLES_PER_SEC
	default	$(dt_node_int_prop_int,/cpus/cpu@0,clock-frequency)

endif # SOC_SERIES_SAMR30
```

## soc/arm/atmel_sam0/samr30/Kconfig.soc
```kconfig
# Atmel SAML MCU series

# Copyright (c) 2021 Argentum Systems Ltd.
# SPDX-License-Identifier: Apache-2.0

choice
	prompt "Atmel SAMR30 MCU Selection"
	depends on SOC_SERIES_SAMR30

config SOC_PART_NUMBER_SAMR30E18A
	bool "SAMR30E18A"
config SOC_PART_NUMBER_SAMR30G18A
	bool "SAMR30G18A"

endchoice
```
